## Documentation/devicetree/bindings/reset/fsl,ls1028a-dp-phy-reset.yaml
```yaml
# SPDX-License-Identifier: GPL-2.0-only OR BSD-2-Clause
%YAML 1.2
---
$id: http://devicetree.org/schemas/reset/fsl,ls1028a-dp-phy-reset.yaml#
$schema: http://devicetree.org/meta-schemas/core.yaml#

title: Freescale LS1028A SoC DisplayPort PHY reset controller

description: |
  The Freescale LS1028A SoC has exactly one reset for the DisplayPort PHY
  on the SoC. This is a simple driver which provides a reset controller for
  it.

maintainers:
  - Michael Walle <michael@walle.cc>

properties:
  compatible:
    const: fsl,ls1028a-dp-phy-reset

  reg:
    maxItems: 1

  "#reset-cells":
    const: 1

required:
  - compatible
  - reg
  - "#reset-cells"

additionalProperties: false

examples:
  - |
    reset-controller@230 {
        compatible = "fsl,ls1028a-dp-phy-reset";
        reg = <0x230 0x01>;
        #reset-cells = <1>;
    };
```

## Documentation/devicetree/bindings/spi/spi-orion.txt
```
Marvell Orion SPI device

Required properties:
- compatible : should be "marvell,orion-spi".
- reg : offset and length of the register set for the device
```

## Documentation/devicetree/bindings/usb/ehci-orion.txt
```
Marvell Orion SoC USB controller

Required properties :
 - compatible : should be "marvell,orion-ehci".
 - phy_version : should be "orion".
```

## drivers/net/dsa/fes/Kconfig
```kconfig
config NET_DSA_FES
	tristate "Flexibilis Ethernet Switch support"
	depends on NET_DSA
	select NET_DSA_TAG_FES
	select NET_PTP_CLASSIFY
	imply PTP_1588_CLOCK

	---help---
	  This enables support for the Flexibilis Ethernet Switch IP core.
```

## drivers/nvmem/layouts/Kconfig
```kconfig
# SPDX-License-Identifier: GPL-2.0

menu "Layout Types"

config NVMEM_LAYOUT_SL28_VPD
	bool "Kontron sl28 VPD layout support"
	select CRC8
	help
	  Say Y here if you want to support the VPD layout of the Kontron
	  SMARC-sAL28 boards.

	  If unsure, say N.

config NVMEM_LAYOUT_U_BOOT_ENV
	bool "U-Boot environment support"
	select CRC32
	help
	  Say Y here if you want to support u-boot's environment.

	  If unsure, say N.

endmenu
```
